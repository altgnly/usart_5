;TERMÝNALE SUAT YAZDIRAN UYGULAMA(KESME ÝLE - 9600BPS - 4 MHZ - YÜKSEK HIZ)
	LIST P=16F877A
	#INCLUDE <P16F877A.INC>
	__CONFIG H'3F31'
	SAYICI1 EQU 0X20
	SAYICI2 EQU 0X21
	ORG 0X000
	GOTO ANA_METOT
	ORG 0X004
	GOTO KESME_METOT

ANA_METOT
	BANKSEL TRISC
	CLRF TRISC		;VERÝ GÖNDERME MODUNDA C PORTU OUTPUT OLARAK KABUL EDÝLÝR.
	BANKSEL PORTC
	CLRF PORTC

	BANKSEL SPBRG
	MOVLW D'25'
	MOVWF SPBRG
	BANKSEL SPBRG

	BANKSEL TXSTA
	MOVLW B'00100100'
	MOVWF TXSTA
	BANKSEL TXSTA

	BANKSEL RCSTA
	MOVLW B'10000000'
	MOVWF RCSTA
	BANKSEL RCSTA

	BANKSEL INTCON
	MOVLW B'11000000'
	MOVWF INTCON
	BANKSEL INTCON

	BANKSEL PIE1
	BSF PIE1,TXIE
	BANKSEL PIE1
	
KONTROL
	GOTO KONTROL

KESME_METOT
	BTFSS PIR1,TXIF
	RETFIE
	
	BANKSEL INTCON
	CLRF INTCON

	MOVLW A'N'
	MOVWF TXREG
	CALL GECIKME

	MOVLW A'I'
	MOVWF TXREG
	CALL GECIKME

	MOVLW A'L'	
	MOVWF TXREG
	CALL GECIKME

	MOVLW A'A'
	MOVWF TXREG
	CALL GECIKME
	
	MOVLW A'Y'
	MOVWF TXREG
	CALL GECIKME

	RETFIE

GECIKME
	MOVLW D'60'
	MOVWF SAYICI1

TEKRAR1
	MOVLW D'130'
	MOVWF SAYICI2

TEKRAR2
	DECFSZ SAYICI2,F
	GOTO TEKRAR2
	DECFSZ SAYICI1,F
	GOTO TEKRAR1
	RETURN

END